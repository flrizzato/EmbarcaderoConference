{ Parsed from Corelocation }
type
  NSPredicateOperator = objcclass external;
  NSHTTPCookieInternal = objcclass external;
  NSHTTPCookieStorageInternal = objcclass external;
  NSConnection = objcclass external;
  NSPortMessage = objcclass external;
  NSHost = objcclass external;
  NSURLAuthenticationChallengeInternal = objcclass external;
  NSCachedURLResponseInternal = objcclass external;
  NSURLCacheInternal = objcclass external;
  NSURLConnectionInternal = objcclass external;
  NSURLCredentialInternal = objcclass external;
  NSURLCredentialStorageInternal = objcclass external;
  NSURLProtectionSpaceInternal = objcclass external;
  NSURLProtocolInternal = objcclass external;
  NSURLRequestInternal = objcclass external;
  NSURLResponseInternal = objcclass external;
  NSHTTPURLResponseInternal = objcclass external;
